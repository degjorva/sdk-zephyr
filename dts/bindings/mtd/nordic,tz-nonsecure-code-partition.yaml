## dts/bindings/mtd/nordic,tz-nonsecure-code-partition.yaml
```yaml
# Copyright (c) 2026 Nordic Semiconductor ASA
# SPDX-License-Identifier: Apache-2.0

description: |
  Tags a flash/RRAM partition as an ARM TrustZone Non-Secure code slot.
  Peer of "nordic,tz-nonsecure-data-partition".

  The TF-M build uses this to compute FLASH_NS_PARTITION_SIZE, the size
  of a single non-secure image slot. Multiple okay nodes are allowed for
  multi-slot MCUboot layouts, but they must all have the same reg size;
  a BUILD_ASSERT enforces this.

  Example:

      slot0_ns_partition: partition@8a000 {
          compatible = "nordic,tz-nonsecure-code-partition";
          label = "image-0-nonsecure";
          reg = <0x0008a000 DT_SIZE_K(940)>;
      };

compatible: "nordic,tz-nonsecure-code-partition"

include: [base.yaml]

properties:
  reg:
    required: true
  label:
    type: string
    required: false
```

## dts/bindings/mtd/nordic,tz-nonsecure-data-partition.yaml
```yaml
# Copyright (c) 2026 Nordic Semiconductor ASA
# SPDX-License-Identifier: Apache-2.0

description: |
  Tags a flash/RRAM partition as ARM TrustZone Non-Secure data (non-secure
  storage, settings, ZMS, ...). Peer of "nordic,tz-nonsecure-code-partition".

  The TF-M build sums both peers to compute the total non-secure flash
  footprint (FLASH_NONSECURE_TOTAL_SIZE) while keeping FLASH_NS_PARTITION_SIZE
  a per-slot value.

  Example:

      storage_partition: partition@175000 {
          compatible = "nordic,tz-nonsecure-data-partition";
          label = "storage";
          reg = <0x00175000 DT_SIZE_K(32)>;
      };

compatible: "nordic,tz-nonsecure-data-partition"

include: [base.yaml]

properties:
  reg:
    required: true
  label:
    type: string
    required: false
```

## dts/bindings/mtd/nordic,tz-secure-code-partition.yaml
```yaml
# Copyright (c) 2026 Nordic Semiconductor ASA
# SPDX-License-Identifier: Apache-2.0

description: |
  Tags a flash/RRAM partition as an ARM TrustZone Secure code slot (e.g.
  the TF-M secure image). Peer of "nordic,tz-secure-data-partition".

  The TF-M build uses this to compute FLASH_S_PARTITION_SIZE, the size
  of a single image slot (consumed as SECURE_IMAGE_MAX_SIZE). Multiple
  okay nodes are allowed for multi-slot MCUboot layouts, but they must
  all have the same reg size; a BUILD_ASSERT enforces this.

  Example:

      slot0_partition: partition@0 {
          compatible = "nordic,tz-secure-code-partition";
          label = "image-0";
          reg = <0x0 DT_SIZE_K(512)>;
      };

compatible: "nordic,tz-secure-code-partition"

include: [base.yaml]

properties:
  reg:
    required: true
  label:
    type: string
    required: false
```

## dts/bindings/mtd/nordic,tz-secure-data-partition.yaml
```yaml
# Copyright (c) 2026 Nordic Semiconductor ASA
# SPDX-License-Identifier: Apache-2.0

description: |
  Tags a flash/RRAM partition as ARM TrustZone Secure data (PS, ITS, OTP,
  NV counters, ...). Peer of "nordic,tz-secure-code-partition".

  The TF-M build sums both peers to compute the total secure flash
  footprint (FLASH_SECURE_TOTAL_SIZE) while keeping FLASH_S_PARTITION_SIZE
  a per-slot value.

  Example:

      tfm_ps_partition: partition@80000 {
          compatible = "nordic,tz-secure-data-partition";
          label = "tfm-ps";
          reg = <0x00080000 DT_SIZE_K(16)>;
      };

compatible: "nordic,tz-secure-data-partition"

include: [base.yaml]

properties:
  reg:
    required: true
  label:
    type: string
    required: false
```
